## Yocto_Recipes/Opcion_1/meta-nasmassembler/conf/layer.conf
```bitbake
# We have a conf and classes directory, add to BBPATH
BBPATH .= ":${LAYERDIR}"

# We have recipes-* directories, add to BBFILES
BBFILES += "${LAYERDIR}/recipes-*/*.bb \
        	${LAYERDIR}/recipes-*/*/*.bbappend"

BBFILE_COLLECTIONS += "nasmassembler"
BBFILE_PATTERN_nasmassembler = "^${LAYERDIR}/"
BBFILE_PRIORITY_nasmassembler = "5"
LAYERVERSION_nasmassembler = "4"
LAYERSERIES_COMPAT_nasmassembler = "warrior"
```

## Yocto_Recipes/Opcion_2/meta-nasmld/conf/layer.conf
```bitbake
# We have a conf and classes directory, add to BBPATH
BBPATH .= ":${LAYERDIR}"

# We have recipes-* directories, add to BBFILES
BBFILES += "${LAYERDIR}/recipes-*/*.bb \
        	${LAYERDIR}/recipes-*/*/*.bbappend"

BBFILE_COLLECTIONS += "nasmld"
BBFILE_PATTERN_nasmld = "^${LAYERDIR}/"
BBFILE_PRIORITY_nasmld = "5"
LAYERVERSION_nasmld = "4"
LAYERSERIES_COMPAT_nasmld = "warrior"
```

## Yocto_Recipes/meta-linker/conf/layer.conf
```bitbake
# We have a conf and classes directory, add to BBPATH
BBPATH .= ":${LAYERDIR}"

# We have recipes-* directories, add to BBFILES
BBFILES += "${LAYERDIR}/recipes-*/*.bb \
        	${LAYERDIR}/recipes-*/*/*.bbappend"

BBFILE_COLLECTIONS += "linker"
BBFILE_PATTERN_linker = "^${LAYERDIR}/"
BBFILE_PRIORITY_linker = "5"
LAYERVERSION_linker = "4"
LAYERSERIES_COMPAT_linker = "warrior"
```
